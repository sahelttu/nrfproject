## CMakeLists.txt
```
# SPDX-License-Identifier: Apache-2.0

cmake_minimum_required(VERSION 3.20.0)

find_package(Zephyr REQUIRED HINTS $ENV{ZEPHYR_BASE})
project(hello_world)

target_sources(app PRIVATE src/main.c)

target_sources(app PRIVATE src/led_control.c)

target_sources(app PRIVATE src/button_handler.c)

target_sources(app PRIVATE src/watchdog_management.c)

target_sources(app PRIVATE src/network.c)

target_sources(app PRIVATE src/mqtt_manage.c)
```

## prj.conf
```kconfig
CONFIG_CONSOLE=y
CONFIG_USE_SEGGER_RTT=y
CONFIG_RTT_CONSOLE=y
CONFIG_UART_CONSOLE=n
CONFIG_PRINTK=y
CONFIG_MQTT_LIB=y
CONFIG_MQTT_CLEAN_SESSION=y
CONFIG_NETWORKING=y
CONFIG_LOG_PRINTK=n
CONFIG_WATCHDOG=y
CONFIG_LTE_LINK_CONTROL=y
#Enables modem library
CONFIG_NRF_MODEM_LIB=y
# Increase memory sizes
CONFIG_HEAP_MEM_POOL_SIZE=4096
CONFIG_MAIN_STACK_SIZE=4096
```

## src/main.c
```c
/*
 * Copyright (c) 2012-2014 Wind River Systems, Inc.
 *
 * SPDX-License-Identifier: Apache-2.0
 */

#include <zephyr/kernel.h>
#include "led_control.h"
#include "button_handler.h"
#include "network.h"
#include "watchdog_management.h"
#include "mqtt_manage.h"
#include <modem/nrf_modem_lib.h>



static button_handler_config buttonconfig;
struct wdt_timeout_cfg toconfig;

	int32_t example_payload_publish(){
		static int32_t some_sensor_value = 23;
		uint8_t message[128];
		uint8_t topic[128];

		sprintf(message, "%d", some_sensor_value++);
		sprintf(topic, "%s/temperature", MQTT_CLIENT_ID);

		printk("Publishing message %s\n", message);
		printk("Topic %s\n", topic);
		return mqtt_manage_publish(message, strlen(message),topic, strlen(topic));
	}

int main(void)
{
	int retcode;
	retcode = nrf_modem_lib_init();
	if(retcode){
		printk(" nrf_modem_lib_init error\n");
	}else{
		printk("nrf_modem_lib_init success\n");
	}

	network_initialize();
	
	printk("Hello IoT World\n");
	toconfig.window.min = 0;
	toconfig.window.max = 20000;
	toconfig.flags = WDT_FLAG_RESET_SOC;
	watchdog_initialize(&toconfig);
	button_handler_initialize(buttonconfig);
	led_control_initialize();

	network_connect();
	mqtt_manage_initialize();
	mqtt_manage_connect();

	example_payload_publish();

	mqtt_manage_disconnect();
	network_disconnect();
	while(1){
		k_msleep(7000);
		watchdog_feed();
		printk("MAIN: Watchdog fed\n");

	}
	return 0;
}
```

## src/button_handler.c
```c
#include "button_handler.h"
#include <zephyr/drivers/gpio.h>
#include <zephyr/sys/printk.h>
#include <zephyr/device.h>
#include <zephyr/drivers/pwm.h>
#include <zephyr/kernel.h>

#define BUTTON_NODE DT_NODELABEL(button0)

struct gpio_dt_spec buttonspec = GPIO_DT_SPEC_GET(BUTTON_NODE, gpios);
gpio_flags_t buttonflags = GPIO_INPUT;

struct gpio_callback button_cb;
static button_handler_config buttonconfig;

void button_cb_handler(const struct device *port, struct gpio_callback *cb, gpio_port_pins_t pins){
    printk("A button has been pressed.\n");
}

int32_t button_handler_initialize(button_handler_config config){
    buttonconfig = config;
    int32_t returncode = 0;
    if (!gpio_is_ready_dt(&buttonspec)){
        printk("Error: Button is not ready.\n");
        return -1;
    }

    printk("Flags: %d\n", buttonspec.dt_flags);
    returncode = gpio_pin_configure_dt(&buttonspec, buttonflags);
    printk("Button %d is ready\n", returncode);
    printk("Success: Button is ready\n");
    gpio_pin_interrupt_configure_dt(&buttonspec, GPIO_INT_EDGE_RISING);
    gpio_init_callback(&button_cb, button_cb_handler, BIT(buttonspec.pin));
    gpio_add_callback_dt(&buttonspec, &button_cb);
    return returncode;
}
```

## src/button_handler.h
```c
#ifndef BUTTON_HANDLER_H
#define BUTTON_HANDLER_H
#include <stdint.h>

#define BUTTON_HANDLER_MAX_PRESS_DURATION           5000        //Maximum duation allowed to be set in the config for minimum_press_duration

/*
Button handler takes in configuration containing a callback function.
Implement the callback function in main.c
Button handler also takes in minimum_press_duration in milliseconds.
This can be used to create simple debounce functionality.
Using minimum_press_duration and implementing debounce functionality is a optional, extra task.
Main task is to implement initialization and have button_handler call provided callback function on putton press.
*/

/*
Recap of GPIO init and settingup callback, documentation online and previous examples will help with details.
Get gpio_dt_spec
Check: gpio_is_ready_dt()
Configure: gpio_pin_configure_dt()
Configure interrupt: gpio_pin_interrupt_configure_dt()
Init callback: gpio_init_callback()
Setup internal callback: gpio_add_callback_dt()
Internal callback will call the function in main.c
*/

typedef struct button_handler_config_s
{
    uint16_t minimum_press_duration;                            //How long should the button be held down to reqister as a push. Value in milliseconds
    void (*button_handler_event_callback)(void);             //Function pointer to callback function responsible of handling the press event
}button_handler_config;             

/*Initialize the button handler.
Initializes the button GPIO, configures it and setups callback.
@return Returns -1 on error, 0 on success*/
int32_t button_handler_initialize(button_handler_config config);




#endif
```

## src/led_control.c
```c
#include "led_control.h"
#include <zephyr/drivers/gpio.h>
#include <zephyr/sys/printk.h>
#include <zephyr/device.h>
#include <zephyr/drivers/pwm.h>
#include <zephyr/kernel.h>


#define LED_RED_NODE DT_NODELABEL(red_led)
#define LED_GREEN_NODE DT_NODELABEL(green_led)
#define LED_BLUE_NODE DT_NODELABEL(blue_led)

#define SLEEP_TIME_MS 1000

struct gpio_dt_spec redspec = GPIO_DT_SPEC_GET(LED_RED_NODE, gpios);
struct gpio_dt_spec greenspec = GPIO_DT_SPEC_GET(LED_GREEN_NODE, gpios);
struct gpio_dt_spec bluespec = GPIO_DT_SPEC_GET(LED_BLUE_NODE, gpios);
gpio_flags_t flags = GPIO_OUTPUT_INACTIVE;

int32_t led_control_initialize(void){
	
    int32_t returncode = 0;
    
    if (!gpio_is_ready_dt(&redspec)||
        !gpio_is_ready_dt(&greenspec)||
        !gpio_is_ready_dt(&bluespec)){
		printk("Error: one or more leds not ready\n");
        return -1;
    }
        printk("flags : %d\n", redspec.dt_flags);
    	returncode = gpio_pin_configure_dt(&redspec, flags);
        printk("Led %d is ready\n", returncode);
        returncode = gpio_pin_configure_dt(&greenspec, flags);
        printk("led %d is ready\n", returncode);
        returncode = gpio_pin_configure_dt(&bluespec, flags);
        printk("led %d is ready\n", returncode);
        printk("Success: leds are ready\n");
        return returncode;
}


int32_t led_control_blink(LED_COLOR1 color,uint8_t count){
     int i;
     for (i=0; i<count; i++){
        led_control_set_state(color, 1);
        k_msleep(SLEEP_TIME_MS);
        led_control_set_state(color, 0);
        k_msleep(SLEEP_TIME_MS);
    }
    return 0;
}

int32_t led_control_set_state(LED_COLOR1 color, LED_STATE state){
    
    int32_t returncode = 0;

    switch(color){
        case LED_COLOR_RED:
        returncode = gpio_pin_set_dt(&redspec, state);
        break;
        case LED_COLOR_GREEN:
        returncode = gpio_pin_set_dt(&greenspec, state);
        break;
        case LED_COLOR_BLUE:
        returncode = gpio_pin_set_dt(&bluespec, state);
        default:
        printk("No color/invalid color was given.\n");
        break;
    }
    printk("%d has blinked\n", color);
    printk("%d\n", returncode);
    return returncode;
}
```

## src/led_control.h
```c
#ifndef LED_CONTROL_H
#define LED_CONTROL_H
#include <stdint.h>

#define LED_CONTROL_MAX_BLINK_COUNT         5       //Optional. Manage maximum requested blinkcount
#define LED_CONTOL_BLINK_STATE_LENGTH_MS    500     //Defines the length of on and off states in milliseconds

/*Color definitions used by functions, defines what color led is used*/
typedef enum LED_COLOR_E
{
    LED_COLOR_RED,
    LED_COLOR_GREEN,
    LED_COLOR_BLUE
} LED_COLOR1;

/*Pin logical state definition*/
typedef enum LED_STATE_E
{
    LED_STATE_OFF = 0,
    LED_STATE_ON = 1,

}LED_STATE;

/*@brief Initialize leds
@return Returns 0 on success, -1 on error
*/
int32_t led_control_initialize(void);

/*@brief Blink led for a given number of times. Uses led_control_set_state(..) internally.
@Note led will be in OFF state after blinkin. 
If led was ON before calling this function, it is first turned to OFF state and then blinked for the given number of times.
Blinker will fail if requested blink count is greater than LED_CONTROL_MAX_BLINK_COUNT
@param[in] color Color of the red requested to be blinked
@param[in] count Number of blinks requested
@return Returns 0 on success, -1 on failure*/
int32_t led_control_blink(LED_COLOR1 color,uint8_t count);

/*@brief Set the state of the led
@param[in] color Color of the led to be controlled
@param[in] state, Requested state for the led 
@return Returns 0 on success, -1 on error*/
int32_t led_control_set_state(LED_COLOR1 color, LED_STATE state);
#endif
```

## src/mqtt_manage.c
```c
#include <zephyr/net/mqtt.h>
#include "mqtt_manage.h"
#include <zephyr/net/socket.h>
#include <zephyr/random/rand32.h>


static struct sockaddr_storage broker;
static struct mqtt_client client;
static uint8_t rx_buffer[MQTT_MESSAGE_BUFFER_SIZE];
static uint8_t tx_buffer[MQTT_MESSAGE_BUFFER_SIZE];

static volatile bool connected = false;
static volatile bool connecting_failed = false;



/**@brief MQTT client event handler
 */
void mqtt_evt_handler(struct mqtt_client *const c,
		      const struct mqtt_evt *evt)
{

	switch (evt->type) {
	case MQTT_EVT_CONNACK:
		if (evt->result != 0) {
			printk("MQTT connect failed: %d\n"
			, evt->result);
			connecting_failed = true;
			break;
		}
		printk("MQTT connect succeeded.\n");
		connected = true;
		break;

	case MQTT_EVT_DISCONNECT:
		if (evt->result != 0) {
			printk("MQTT connect failed: %d\n"
			, evt->result);
			break;
		}
		printk("MQTT disconnect succeeded.\n");
		connected = false;
		break;

	default:
		printk("Unhandled MQTT event type: %d\n", evt->type);
		break;
	}
}


static int broker_init(void)
{
	int err;
	struct addrinfo *result;
	struct addrinfo *addr;
	struct addrinfo hints = {
		.ai_family = AF_INET,
		.ai_socktype = SOCK_STREAM
	};

	err = getaddrinfo(MQTT_BROKER_HOST, NULL, &hints, &result);
	if (err) {
		printk("getaddrinfo failed: %d\n", err);
		return -ECHILD;
	}

	addr = result;

	/* Look for address of the broker. */
	while (addr != NULL) {
		/* IPv4 Address. */
		if (addr->ai_addrlen == sizeof(struct sockaddr_in)) {
			struct sockaddr_in *broker4 =
				((struct sockaddr_in *)&broker);
			char ipv4_addr[NET_IPV4_ADDR_LEN];

			broker4->sin_addr.s_addr =
				((struct sockaddr_in *)addr->ai_addr)
				->sin_addr.s_addr;
			broker4->sin_family = AF_INET;
			broker4->sin_port = htons(MQTT_BROKER_PORT);

			inet_ntop(AF_INET, &broker4->sin_addr.s_addr,
				  ipv4_addr, sizeof(ipv4_addr));
			printk("IPv4 Address found %s\n", (char *)(ipv4_addr));

			break;
		} else {
			printk("ai_addrlen = %u should be %u or %u",
				(unsigned int)addr->ai_addrlen,
				(unsigned int)sizeof(struct sockaddr_in),
				(unsigned int)sizeof(struct sockaddr_in6));
		}

		addr = addr->ai_next;
	}

	/* Free the address. */
	freeaddrinfo(result);

	return err;
}

int32_t mqtt_manage_initialize()
{
    int retcode;
	mqtt_client_init(&client);
	retcode = broker_init();
	if(retcode){
	printk("broker_init() failed\n");
	return -1;
	}

	/* MQTT client configuration */
	client.broker = &broker; //MQTT broker connection data
	client.evt_cb = mqtt_evt_handler; //Event handler for MQTT events
	client.client_id.utf8 = MQTT_CLIENT_ID; //Change to your own in .h
	client.client_id.size = strlen(client.client_id.utf8); //Size of client id
	client.password = NULL; //We will not used password
	client.user_name = NULL; //We will not use user name
	client.protocol_version = MQTT_VERSION_3_1_1; //Set MQTT protocol version
	client.transport.type = MQTT_TRANSPORT_NON_SECURE; //We will not use TLS at this point

	/* MQTT buffers configuration */
	client.rx_buf = rx_buffer;
	client.rx_buf_size = sizeof(rx_buffer);
	client.tx_buf = tx_buffer;
	client.tx_buf_size = sizeof(tx_buffer);

	return 0;

}


int32_t mqtt_manage_connect()
{
    connected = false;
	connecting_failed = false;
	int retcode;


	retcode = mqtt_connect(&client);
	if(retcode){
		printk("mqtt_connect() failed");
		return -1;
	}

	do{
		mqtt_input(&client);
		printk("Waiting mqtt for connection\n");
		k_msleep(3000);
	}while(!connected && !connecting_failed);

    return 0;
}

int32_t mqtt_manage_disconnect()
{
    int retcode;


	retcode = mqtt_disconnect(&client);
	if(retcode){
		printk("mqtt_disconnect() failed");
		return -1;
	}

	do{
		mqtt_input(&client);
		printk("Waiting mqtt for disconnection\n");
		k_msleep(3000);
	}while(connected && !connecting_failed);

    return 0;
}

int32_t mqtt_manage_publish(uint8_t *payload, size_t payload_length, uint8_t *topic, size_t topic_length)
{
	struct mqtt_publish_param param;
	int retval = 0;
	param.dup_flag = 0;
	param.message.topic.qos = MQTT_QOS_0_AT_MOST_ONCE;
	param.message.payload.data = payload;
	param.message.payload.len = payload_length;
	param.message.topic.topic.utf8 = topic;
	param.message.topic.topic.size = topic_length;
	param.message_id = sys_rand32_get();
	param.retain_flag = 0;
	
	retval = mqtt_publish(&client, &param);
	if(retval){
		printk("mqtt_publish failed.\n");
		return -1;
	}
	printk("mqtt_publish succeeded.\n");
	return 0;
}
```

## src/mqtt_manage.h
```c
#ifndef MQTT_MANAGE_H
#define MQTT_MANAGE_H
#include <stdint.h>
#include <zephyr/net/mqtt.h>

#define MQTT_CLIENT_ID              "oregano5085"  //set to something unique.
#define MQTT_MESSAGE_BUFFER_SIZE    256
#define MQTT_PAYLOAD_BUFFER_SIZE    256
#define MQTT_BROKER_PORT            1883
#define MQTT_BROKER_HOST            "broker.hivemq.com"

/*@brief Initializes the mqtt client struct and resolves broker connection data
@Note Prints success and failure information
return 0 on success, -1 on error*/
int32_t mqtt_manage_initialize();

/*@brief Connects to a MQTT broker
@Note Blocks until connected, no timeout functionality at the moment
@return return -1 on error, 0 on success*/
int32_t mqtt_manage_connect();

/*@brief Disconnects from the MQTT broker
@Note Blocks until disconnected, no timout functionality at the moment
@return returns -1 on error 0 on success*/
int32_t mqtt_manage_disconnect();

/*@brief Sends MQTT message
@note Suports only QoS0 and no retain at the moment
@param[in] *payload Message payload string
@param[in] payload_length Length of the payload, use strlen
@param[in] *topic Topic payload string
@param[in] topic_length Length of the payload, use strlen
@return Return -1 on error, 0 on success
*/
int32_t mqtt_manage_publish(uint8_t *payload, size_t payload_length, uint8_t *topic, size_t topic_length);

/*
https://developer.nordicsemi.com/nRF_Connect_SDK/doc/latest/zephyr/connectivity/networking/api/mqtt.html
https://developer.nordicsemi.com/nRF_Connect_SDK/doc/latest/zephyr/connectivity/networking/api/mqtt.html#mqtt-api-reference
*/
#endif
```

## src/network.c
```c
#include "network.h"
#include <zephyr/kernel.h>
#include <modem/lte_lc.h>
#include "led_control.h"
#include "watchdog_management.h"

volatile bool connecting = false;

/*@brief Initialize network module
@Note Calls lte_lc_init(); and prints error message on error, success message on success
@return Returns -1 on error, 0 on success*/
int32_t network_initialize(){
    int retcode;
    retcode = lte_lc_init();
    if(retcode){
        printk("lte_lc_init failed\n");
        return -1;
    }else{
        printk("lte_lc_init succeeded\n");
        return 0;
    }
}

/*@brief Connect to network.
@Note While searching for network and trying to connect, system blinks with blue lights.
Once connected, green light will blink three times.
This function does not return until a connection is made. (timeout functionality not yet implemented)
@return Returns 0 on success (connection is established) -1 on error*/
int32_t network_handler(const struct lte_lc_evt *const evt){


         switch (evt->type) {
     case LTE_LC_EVT_NW_REG_STATUS:
             if ((evt->nw_reg_status != LTE_LC_NW_REG_REGISTERED_HOME) &&
             (evt->nw_reg_status != LTE_LC_NW_REG_REGISTERED_ROAMING)) {
                     break;
             }

             printk("Connected to: %s network\n",
             evt->nw_reg_status == LTE_LC_NW_REG_REGISTERED_HOME ? "home" : "roaming");
             connecting = false;
             break;
     case LTE_LC_EVT_PSM_UPDATE:
     case LTE_LC_EVT_EDRX_UPDATE:
     case LTE_LC_EVT_RRC_UPDATE:
     case LTE_LC_EVT_CELL_UPDATE:
     case LTE_LC_EVT_LTE_MODE_UPDATE:
     case LTE_LC_EVT_TAU_PRE_WARNING:
     case LTE_LC_EVT_NEIGHBOR_CELL_MEAS:
     case LTE_LC_EVT_MODEM_SLEEP_EXIT_PRE_WARNING:
     case LTE_LC_EVT_MODEM_SLEEP_EXIT:
     case LTE_LC_EVT_MODEM_SLEEP_ENTER:
             /* Callback events carrying LTE link data */
             break;
     default:
             break;
     }

}

int32_t network_connect(){
    int retcode;
    retcode = lte_lc_connect_async(network_handler);
    connecting = true;
    while(connecting){
        led_control_blink(LED_COLOR_BLUE, 3);
        k_msleep(7000);
		watchdog_feed();
		printk("NETWORK: Watchdog fed\n");
    }
    led_control_blink(LED_COLOR_GREEN, 1);
    led_control_blink(LED_COLOR_GREEN, 1);
    led_control_blink(LED_COLOR_GREEN, 1);
}


/*@brief Sets the modem in offline mode
@Note prints information about success of the disconnecting process
@return Returns 0 on success, -1 on error*/
int32_t network_disconnect(){
    int retcode;
    retcode = lte_lc_offline();
    if (retcode){
        printk("Disconnect failed\n");
    }else{
        printk("Disconnect successful\n");
    }
}
```

## src/network.h
```c
#ifndef NETWORK_H
#define NETWORK_H
#include <stdint.h>

/*@brief Initialize network module
@Note Calls lte_lc_init(); and prints error message on error, success message on success
@return Returns -1 on error, 0 on success*/
int32_t network_initialize();

/*@brief Connect to network.
@Note While searching for network and trying to connect, system blinks with blue lights.
Once connected, green light will blink three times.
This function does not return until a connection is made. (timeout functionality not yet implemented)
@return Returns 0 on success (connection is established) -1 on error*/
int32_t network_connect();

/*@brief Sets the modem in offline mode
@Note prints information about success of the disconnecting process
@return Returns 0 on success, -1 on error*/
int32_t network_disconnect();

#endif
```

## src/watchdog_management.c
```c
#include "watchdog_management.h"
#include <zephyr/device.h>
#include <zephyr/kernel.h>
#include <zephyr/sys/printk.h>


#define WATCHDOG_NODE_IDENTIFIER DT_NODELABEL(wdt0)

const struct device *wdt_device = DEVICE_DT_GET(WATCHDOG_NODE_IDENTIFIER);
int channelid;
int feedreturn;

int32_t watchdog_initialize(struct wdt_timeout_cfg *wdt_config){
    


    if(!device_is_ready(wdt_device)){
        printk("Device is not ready\n");
        return -1;
    }
    channelid = wdt_install_timeout(wdt_device, wdt_config);
    printk("Channel ID: %d\n", channelid);
    printk("WATCHDOG: Device is ready\n");
    wdt_setup(wdt_device, WDT_OPT_PAUSE_HALTED_BY_DBG);
    printk("WATCHDOG: Device is setup\n");
    return 0;
}

void watchdog_feed(void){
    feedreturn = wdt_feed(wdt_device, channelid);
    printk("Feed: %d\n", feedreturn);
}
```

## src/watchdog_management.h
```c
#ifndef WATCHDOG_MANAGEMENT_H
#define WATCHDOG_MANAGEMENT_H
#include <zephyr/drivers/watchdog.h>

/*
This system initializes watchdog timer with configuration we have defined in main.c
System at early stage supports only one watchdog channel
*/

/*@brief Initializes and configures watchdog timer
@param[in] *wdt_config A pointer to watchdog configuration struct
@return Returns -1 on error, 0 on success*/
int32_t watchdog_initialize(struct wdt_timeout_cfg *wdt_config);

/*@brief Resets watchdog counter*/
void watchdog_feed(void);

#endif
```
